#include <stdio.h>
#include "stm32f10x.h"	 
#include "NTC.h"
#include "IntToString.h"	

unsigned char NTC_Temp_s(const float* tab, float mrs, char* s)
{
	unsigned int teep1 = 0, teep2 = 150;
	int temp1,temp2;
	char* buff = s;
	char buff1;
	
	if(mrs < table_10K_3435[teep2]) return 0;
	if(mrs > table_10K_3435[teep1]) return 0;
	
	while(1 != (teep2-teep1))
	{
		if(mrs < table_10K_3435[(teep1+teep2)/2]) teep1 = (teep1+teep2)/2;
		else 
			if(mrs > table_10K_3435[(teep1+teep2)/2]) teep2 = (teep1+teep2)/2;
			else 
			{
				teep1 = (teep1+teep2)/2;
				teep2 = teep1+1;
			}
	}
	
	temp1 = teep1*100 - 5000;
	//插值
	temp1 += (unsigned int)(100*(mrs-table_10K_3435[teep1])/(table_10K_3435[teep2]-table_10K_3435[teep1]));
	if(5 <= (temp1%10)) temp1 += 10;
	temp1 /= 10;
	
	Int_To_String(temp1,buff);
	
	if('-' == *buff) buff++;
	
	if('0' != *buff) 
	{
		if(NULL != *(buff+1))
		{
			while(NULL != *buff) buff++;
			
			buff--; 
			buff1 = *buff;
			*buff = '.';
			*(buff+1) = buff1;
			*(buff+2) = NULL;
		}
		else
		{
			buff1 = *buff;
			*buff = '0';
			*(buff+1) = '.';
			*(buff+2) = buff1;
			*(buff+3) = NULL;
		}
	}
	
	buff = s;
	for(teep1 = 0; NULL != *buff; teep1++) buff++;
	
	return teep1;
}

const float table_10K_3435[]=										//-50~110(step:1)						
{ 
	329.5 , 310.9 , 293.5 , 277.2 , 262.0 , 247.7 , 234.3 , 221.7 , 209.9 , 198.9 ,
	188.5 , 178.5 , 169.0 , 160.2 , 151.9 , 144.1 , 136.7 , 129.8 , 123.3 , 117.1 ,
	111.3 , 105.7 , 100.5 , 95.52 , 90.84 , 86.43 , 82.26 , 78.33 , 74.61 , 71.10 ,
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	0.9731 , 0.9484 , 0.9246 , 0.9014 , 0.8789 , 0.8572 , 0.8360 , 0.8155 , 0.7956 , 0.7763 ,
	0.7576
};
